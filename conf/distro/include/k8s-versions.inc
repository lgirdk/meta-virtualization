## conf/distro/include/k8s-versions.inc
```bitbake
# Use go 1.12 to avoid k8s build failure.
# Remove this after https://github.com/kubernetes/kubernetes/issues/82531 is resolved and k8s is updated to a working version.
GOVERSION = "1.12%"
```

## conf/distro/include/meta-virt-container-containerd.inc
```bitbake
include meta-virt-container.inc

## CNCF "components"

# engines: docker/docker-moby, virtual-containerd, cri-o, podman, lxc
VIRTUAL-RUNTIME_container_engine ??= "containerd"
# runtime: runc, crun, runv, runx
VIRTUAL-RUNTIME_container_runtime ??= "crun"
# networking: cni, netavark
VIRTUAL-RUNTIME_container_networking ??= "cni"
# dns: cni, aardvark-dns
VIRTUAL-RUNTIME_container_dns ??= ""
# orchestration: k8s, k3s
VIRTUAL-RUNTIME_container_orchestration ??= ""

VIRTUAL-RUNTIME_cri ??= "virtual-containerd"
VIRTUAL-RUNTIME_cni ??= "cni"
```

## conf/distro/include/meta-virt-container-docker.inc
```bitbake
include meta-virt-container.inc

## CNCF "components"

# engines: docker/docker-moby, virtual-containerd, cri-o, podman, lxc
VIRTUAL-RUNTIME_container_engine ??= "docker-moby"
# runtime: runc, crun, runv, runx
VIRTUAL-RUNTIME_container_runtime ??= "virtual-runc"
# networking: cni, netavark
VIRTUAL-RUNTIME_container_networking ??= ""
# dns: cni, aardvark-dns
VIRTUAL-RUNTIME_container_dns ??= ""
# orchestration: k8s, k3s
VIRTUAL-RUNTIME_container_orchestration ??= ""

VIRTUAL-RUNTIME_cri ??= "virtual-containerd"
VIRTUAL-RUNTIME_cni ??= "cni"
```

## conf/distro/include/meta-virt-container-k3s-host.inc
```bitbake
include meta-virt-container.inc

VIRTUAL-RUNTIME_container_engine ?= ""
VIRTUAL-RUNTIME_container_runtime ?= ""
VIRTUAL-RUNTIME_container_networking ?= ""
VIRTUAL-RUNTIME_container_dns ?= ""
VIRTUAL-RUNTIME_container_orchestration ?= "k3s-host"

## Kubernetes terminology "components"
VIRTUAL-RUNTIME_cri ?= "virtual-containerd"
VIRTUAL-RUNTIME_cni ?= "cni"
```

## conf/distro/include/meta-virt-container-k3s-node.inc
```bitbake
require meta-virt-container-k3s-host.inc

VIRTUAL-RUNTIME_container_orchestration = "k3s-node"
```

## conf/distro/include/meta-virt-container-podman.inc
```bitbake
include meta-virt-container.inc

VIRTUAL-RUNTIME_container_engine ?= "podman"
VIRTUAL-RUNTIME_container_runtime ?= "crun"
VIRTUAL-RUNTIME_container_networking ?= "netavark"
VIRTUAL-RUNTIME_container_dns ?= "aardvark-dns"
VIRTUAL-RUNTIME_container_orchestration ?= ""

## Kubernetes terminology "components"
VIRTUAL-RUNTIME_cri ?= "virtual-containerd"
VIRTUAL-RUNTIME_cni ?= "cni"
```

## conf/distro/include/meta-virt-container.inc
```bitbake
# These variables represent groupings of functionality in the CNCF
# landscape. In particular, they are areas where there is a choice
# between more than one implementation or an area where abstraction
# is beneficial.
#
# The contents of the variables are are runtime components that
# recipes may use for RDEPENDS.
#
# Build dependencies are not typically flexible, so do not currently
# have DEPENDS equivalents for the components (i.e. DEPENDS on runc
# versus crun).
#
# Distro features such as kubernetes or other container stacks
# can be used to set different defaults for these variables.
#
# Note: these are "global" values, since they represent choices.
# If more than of a grouping is required on target, then the variable
# can be appended or set to multiple values. That being said, Recipes
# should generally agree on the values, hence the global namespace.
# Recipe specific choices  can still be done, but they risk
# conflicting on target or causing runtime issues / errors.
#

## CNCF "components"

# engines: docker-ce/docker-moby, virtual-containerd, cri-o, podman
VIRTUAL-RUNTIME_container_engine ??= "podman"
# runtime: runc, crun, runv, runx
VIRTUAL-RUNTIME_container_runtime ??= "virtual-runc"
# networking: cni, netavark
VIRTUAL-RUNTIME_container_networking ??= "cni"
# dns: cni, aardvark-dns
VIRTUAL-RUNTIME_container_dns ??= "cni"
# orchestration: k8s, k3s
VIRTUAL-RUNTIME_container_orchestration ??= "k3s"

## Kubernetes terminology "components"

VIRTUAL-RUNTIME_cri ??= "virtual-containerd"
VIRTUAL-RUNTIME_cni ??= "cni"
```

## conf/distro/include/meta-virt-default-versions.inc
```bitbake
# Meta-virtuailization PREFERED_VERSION

PREFERRED_VERSION_xen ?= "4.19%"
PREFERRED_VERSION_xen-tools ?= "4.19%"
```

## conf/distro/include/meta-virt-xen.inc
```bitbake
# Make sure Xen mode is enabled in qemu
PACKAGECONFIG_append_pn-qemu = " xen"

# For builds for ARM platforms, enable fdt
PACKAGECONFIG_append_pn-qemu_arm = " fdt"
PACKAGECONFIG_append_pn-qemu_aarch64 = " fdt"

# Xen on Raspberry Pi 4 64-bit support
XEN_RPI4_64_CONFIG_PATH ??= \
    'dynamic-layers/raspberrypi/conf/distro/include/xen-raspberrypi4-64.inc'
include ${@bb.utils.contains('MACHINE', 'raspberrypi4-64', \
    '${XEN_RPI4_64_CONFIG_PATH}', '', d)}
```

## conf/distro/minimal.conf
```bitbake
include conf/distro/defaultsetup.conf

USE_LDCONFIG = "0"
VIRTUAL-RUNTIME_dev_manager = "busybox-mdev"
SYSVINIT_ENABLED_GETTYS = ""
SERIAL_CONSOLE = "115200 ttyS0"
```

## conf/layer.conf
```bitbake
# We have a conf and classes directory, append to BBPATH
BBPATH .= ":${LAYERDIR}"

# We have a recipes directory, add to BBFILES
BBFILES += "${LAYERDIR}/recipes*/*/*.bb ${LAYERDIR}/recipes*/*/*.bbappend"

BBFILE_COLLECTIONS += "virtualization-layer"
BBFILE_PATTERN_virtualization-layer := "^${LAYERDIR}/"
BBFILE_PRIORITY_virtualization-layer = "8"

# Custom licenses used by some packages in this layer
LICENSE_PATH += "${LAYERDIR}/files/custom-licenses"

# The dynamic-layers directory hosts extensions and layer-specific
# modifications.
#
# The .bbappend and .bb files are included if the respective layer
# collection is available.
BBFILES += "${@' '.join('${LAYERDIR}/dynamic-layers/%s/recipes*/*/*.bbappend' % layer \
               for layer in BBFILE_COLLECTIONS.split())}"
BBFILES += "${@' '.join('${LAYERDIR}/dynamic-layers/%s/recipes*/*/*.bb' % layer \
               for layer in BBFILE_COLLECTIONS.split())}"

BBFILES_DYNAMIC += " \
    raspberrypi:${LAYERDIR}/dynamic-layers/raspberrypi/*/*/*.bb \
    raspberrypi:${LAYERDIR}/dynamic-layers/rasbperrypi/*/*/*.bbappend \
    xilinx:${LAYERDIR}/dynamic-layers/xilinx/*/*/*.bb \
    xilinx:${LAYERDIR}/dynamic-layers/xilinx/*/*/*.bbappend \
"

# This should only be incremented on significant changes that will
# cause compatibility issues with other layers
LAYERVERSION_virtualization-layer = "1"
LAYERSERIES_COMPAT_virtualization-layer = "dunfell gatesgarth"
LAYERDEPENDS_virtualization-layer = " \
    core \
    openembedded-layer \
    networking-layer \
    filesystems-layer \
    meta-python \
"

# webserver: naigos requires apache2
LAYERRECOMMENDS_virtualization-layer = " \
    webserver \
    selinux \
"

# Override security flags
require conf/distro/include/virt_security_flags.inc

PREFERRED_PROVIDER_virtual/runc ?= "runc-docker"
PREFERRED_PROVIDER_virtual/containerd ?= "containerd-opencontainers"
PREFERRED_PROVIDER_virtual/docker ?= "docker-ce"

# Sanity check for meta-virtualization layer.
# Setting SKIP_META_VIRT_SANITY_CHECK to "1" would skip the bbappend files check.
INHERIT += "sanity-meta-virt"

# We need to load the meta-virt config components, only if "virtualization"
# is in the distro features.  Since we don't know the distro flags during
# layer.conf load time, we delay using a special bbclass that simply includes
# the META_VIRT_CONFIG_PATH file, and likewise for the Xen and k8s configs
META_VIRT_CONFIG_PATH = "${LAYERDIR}/conf/distro/include/meta-virt-default-versions.inc"
META_VIRT_XEN_CONFIG_PATH = "${LAYERDIR}/conf/distro/include/meta-virt-xen.inc"
K8S_CONFIG_PATH = "${LAYERDIR}/conf/distro/include/k8s-versions.inc"
USER_CLASSES_append = " meta-virt-cfg"
USER_CLASSES_append = " meta-virt-k8s-cfg"
USER_CLASSES_append = " meta-virt-xen-cfg"
```

## dynamic-layers/raspberrypi/conf/distro/include/xen-raspberrypi4-64.inc
```bitbake
# Xen on Raspberry Pi 4 settings

# Xen uses u-boot for configuration and uses the uart
RPI_USE_U_BOOT = "1"
ENABLE_UART = "1"

# Build the bootable SD card image
IMAGE_CLASSES_append = " sdcard_image-rpi"
IMAGE_FSTYPES_append = " rpi-sdimg"

# Add Xen to the bootable SD card image
RPI_SDIMG_EXTRA_DEPENDS_append = " xen:do_deploy"
DEPLOYPAYLOAD = "xen-${MACHINE}:xen"

# We need the GIC enabled for Xen to work
RPI_EXTRA_CONFIG_append  = "\nenable_gic=1"

# Increase boot partition for space for kernel and Xen
BOOT_SPACE = "61440"

# Override the meta-raspberrypi default kernel preference
PREFERRED_PROVIDER_virtual/kernel ?= "linux-yocto"
KERNEL_DEVICETREE ?= "broadcom/bcm2711-rpi-4-b.dtb"

PREFERRED_PROVIDER_u-boot-default-script ?= "xen-rpi-u-boot-scr"
```
